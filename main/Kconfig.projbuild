## main/Kconfig.projbuild
```kconfig
# @file      Kconfig.projbuild
# @brief     mender-esp32-example main Kconfig
#
# Copyright joelguittet and mender-mcu-client contributors
#
# Licensed under the Apache License, Version 2.0 (the "License");
# you may not use this file except in compliance with the License.
# You may obtain a copy of the License at
#
#     http://www.apache.org/licenses/LICENSE-2.0
#
# Unless required by applicable law or agreed to in writing, software
# distributed under the License is distributed on an "AS IS" BASIS,
# WITHOUT WARRANTIES OR CONDITIONS OF ANY KIND, either express or implied.
# See the License for the specific language governing permissions and
# limitations under the License.

orsource "../components/mender-mcu-client/mender-mcu-client/esp-idf/Kconfig"

menu "Example Configuration"

    config EXAMPLE_AUTHENTICATION_FAILS_MAX_TRIES
        int "Maximum number of retries when Mender client authentification fails"
        default 3
        help
            Defines the number of retries when the Mender client authentification fails before the artifact is considered invalid and the rollback is done.

endmenu
```

## sdkconfig.defaults
```kconfig
# @file      sdkconfig.defaults
# @brief     sdkconfig defaults
#
# Copyright joelguittet and mender-mcu-client contributors
#
# Licensed under the Apache License, Version 2.0 (the "License");
# you may not use this file except in compliance with the License.
# You may obtain a copy of the License at
#
#     http://www.apache.org/licenses/LICENSE-2.0
#
# Unless required by applicable law or agreed to in writing, software
# distributed under the License is distributed on an "AS IS" BASIS,
# WITHOUT WARRANTIES OR CONDITIONS OF ANY KIND, either express or implied.
# See the License for the specific language governing permissions and
# limitations under the License.

CONFIG_BOOTLOADER_APP_ROLLBACK_ENABLE=y
# CONFIG_BOOTLOADER_APP_ANTI_ROLLBACK is not set
# CONFIG_ESPTOOLPY_FLASHSIZE_2MB is not set
CONFIG_ESPTOOLPY_FLASHSIZE_4MB=y
CONFIG_ESPTOOLPY_FLASHSIZE="4MB"
# CONFIG_PARTITION_TABLE_SINGLE_APP is not set
CONFIG_PARTITION_TABLE_CUSTOM=y
CONFIG_MENDER_CLIENT_ADD_ON_CONFIGURE=y
CONFIG_ESP_MAIN_TASK_STACK_SIZE=4096
CONFIG_ESP_TASK_WDT_TIMEOUT_S=60
CONFIG_FREERTOS_TIMER_TASK_STACK_DEPTH=3072
CONFIG_WS_BUFFER_SIZE=4096
```
